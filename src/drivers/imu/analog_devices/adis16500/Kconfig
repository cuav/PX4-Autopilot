## src/drivers/imu/analog_devices/adis16500/Kconfig
```kconfig
menuconfig DRIVERS_IMU_ANALOG_DEVICES_ADIS16500
	bool "ADIS16500"
	default n
	---help---
		Enable support for analog_devices ADIS16500
```

## src/drivers/imu/invensense/iam20685/Kconfig
```kconfig
menuconfig DRIVERS_IMU_INVENSENSE_IAM20685
	bool "iam20685"
	default n
	---help---
		Enable support for iam20685
```
